## vendor/uboot/clockworkpi-a04-h6_defconfig
```kconfig
CONFIG_ARM=y
CONFIG_ARCH_SUNXI=y
CONFIG_MACH_SUN50I_H6=y
CONFIG_SUNXI_DRAM_H6_LPDDR3=n
CONFIG_SUNXI_DRAM_H6_DDR3_1333=y
CONFIG_DRAM_ODT_EN=y
CONFIG_MMC0_CD_PIN="PF6"
CONFIG_MMC_SUNXI_SLOT_EXTRA=2
CONFIG_HDMI_DDC_EN="PH2"
CONFIG_DEFAULT_DEVICE_TREE="sun50i-h6-clockworkpi-a04"
CONFIG_SPL=y
CONFIG_DISTRO_DEFAULTS=y
CONFIG_SYS_BOOTM_LEN=0x4000000
CONFIG_BOOTDELAY=0

CONFIG_SUNXI_SCP_BASE=0x0
CONFIG_ENV_IS_NOWHERE=y
CONFIG_BOOTMETH_SCRIPT=y
```
